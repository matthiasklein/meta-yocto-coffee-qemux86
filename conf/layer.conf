## conf/layer.conf
```bitbake
# We have a conf and classes directory, add to BBPATH
BBPATH .= ":${LAYERDIR}"

# We have recipes-* directories, add to BBFILES
BBFILES += "${LAYERDIR}/recipes-*/*/*.bb \
            ${LAYERDIR}/recipes-*/*/*.bbappend"

BBFILE_COLLECTIONS += "meta-yocto-coffee-qemux86"
BBFILE_PATTERN_meta-yocto-coffee-qemux86 = "^${LAYERDIR}/"
BBFILE_PRIORITY_meta-yocto-coffee-qemux86 = "6"

LAYERDEPENDS_meta-yocto-coffee-qemux86 = "core"
LAYERSERIES_COMPAT_meta-yocto-coffee-qemux86 = "honister"
```

## conf/local.conf.sample
```bitbake
#MACHINE ??= "qemux86-64"
MACHINE ??= "intel-corei7-64"

# disable intel-media-driver from meta-intel/conf/machine/intel-skylake-64.conf which can not be build without opengl
MACHINE_HWCODECS = ""
PREFERRED_PROVIDER_virtual/kernel = "linux-intel-rt"
PREFERRED_VERSION_linux-intel-rt = "5.10%"

# Needed to run Qt code
QB_CPU:append = ",+ssse3,+sse4.1,+sse4.2,+popcnt"
QB_CPU_KVM:append = ",+ssse3,+sse4.1,+sse4.2,+popcnt"

# tar.bz2 is needed for RAUC bundle creation
IMAGE_FSTYPES = "tar.bz2 wic"
DISTRO_FEATURES:append = " rauc"
PREFERRED_RPROVIDER_virtual-grub-bootconf = "rauc-grubconf"
RAUC_KEYRING_FILE="${THISDIR}/../../../meta-distro-coffee/openssl-ca/dev/ca.cert.pem"
RAUC_KEY_FILE="${THISDIR}/../../../meta-distro-coffee/openssl-ca/dev/private/development-1.key.pem"
RAUC_CERT_FILE="${THISDIR}/../../../meta-distro-coffee/openssl-ca/dev/development-1.cert.pem"

# Saves about 630MB of flash
MACHINE_EXTRA_RRECOMMENDS:remove = " linux-firmware"

# Needed for runqemu (in combination with meta-intel)
EXTRA_IMAGEDEPENDS += "qemu-system-native qemu-helper-native:do_addto_recipe_sysroot"

DL_DIR ?= "${BSPDIR}/downloads"
SSTATE_DIR ?= "${BSPDIR}/sstate-cache"
INHERIT += "rm_work"

DISTRO ?= "coffee"
PACKAGE_CLASSES ?= "package_ipk"

EXTRA_IMAGE_FEATURES ?= "debug-tweaks"
USER_CLASSES ?= "buildstats image-prelink"
PATCHRESOLVE = "noop"

WKS_FILE = "qemux86-efi.wks"

BB_DISKMON_DIRS ??= "\
    STOPTASKS,${TMPDIR},1G,100K \
    STOPTASKS,${DL_DIR},1G,100K \
    STOPTASKS,${SSTATE_DIR},1G,100K \
    STOPTASKS,/tmp,100M,100K \
    ABORT,${TMPDIR},100M,1K \
    ABORT,${DL_DIR},100M,1K \
    ABORT,${SSTATE_DIR},100M,1K \
    ABORT,/tmp,10M,1K"

CONF_VERSION = "2"
```

## wic/qemux86-efi.wks
```
# short-description: Create an EFI disk image
# long-description: Creates a partitioned EFI disk image with Dual-Boot and RAUC
# 
# The partitionging scheme provides:
# * a bootloader partition with extra space for a shadow copy for atomic bootloader updates
# * a grub environment partition
# * two root file system partitions for atomic updates
# * a common data partition

# Note: The grubenv partition is created empty. RAUC creates the initial file at first startup.
#       From then on grub also uses this file. (Grub does not create an initial file itself).

# Note: The fstab is modified via the recipe base-files_%.bbappend, because the modification must also be included in the RAUC bundle.
#       This would not be the case if the fstab was modified by WIC.

# Note: The boot partition is generated via the recipe boot-image.bb (efi-boot.vfat image) for updating the partition via a RAUC bundle.

bootloader --ptable gpt
part --align 4096 --fixed-size 50M  --fstype=vfat --label boot     --source rawcopy --sourceparams="file=efi-boot.vfat" --active
part --align 4096 --fixed-size 50M  --no-table
part --align 4096 --fixed-size 10M  --fstype=vfat --label grubenv 
part --align 4096                   --fstype=ext4 --label coffeea --source rootfs
part --align 4096                   --fstype=ext4 --label coffeeb --source rootfs
part --align 4096 --fixed-size 200M --fstype=ext4 --label workspace
```
